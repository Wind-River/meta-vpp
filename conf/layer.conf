## conf/layer.conf
```bitbake
# We have a conf and classes directory, add to BBPATH
BBPATH .= ":${LAYERDIR}"

# We have recipes-* directories, add to BBFILES
BBFILES += "${LAYERDIR}/recipes-*/*/*.bb \
            ${LAYERDIR}/recipes-*/*/*.bbappend"

BBFILE_COLLECTIONS += "vpp-layer"
BBFILE_PATTERN_vpp-layer := "^${LAYERDIR}/"
BBFILE_PRIORITY_vpp-layer = "5"

LAYERDEPENDS_vpp-layer = "\
	core \
	networking-layer \
"

# This should only be incremented on significant changes that will
# cause compatibility issues with other layers
LAYERVERSION_vpp-version = "1"
LAYERSERIES_COMPAT_vpp-layer = "thud"

PNWHITELIST_LAYERS_remove = " vpp-layer"
PNWHITELIST_LAYERS_remove = " networking-layer"
PNWHITELIST_LAYERS_remove = " dpdk"
```
